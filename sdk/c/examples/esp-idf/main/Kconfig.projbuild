## sdk/c/examples/esp-idf/main/Kconfig.projbuild
```kconfig
menu "Struct telemetry example"
config STRUCT_GATEWAY
 string "Gateway numeric IPv4"
 default "127.0.0.1"
config STRUCT_KEY_ID
 string "Device key ID"
 default "REPLACE"
config STRUCT_API_SECRET
 string "Device API secret (never share sdkconfig)"
 default "REPLACE"
config STRUCT_ENCRYPTION_KEY
 string "Optional device encryption key (64 hex)"
 default ""
endmenu
```

## sdk/c/integrations/zephyr/Kconfig
```kconfig
menu "Struct device SDK"
config STRUCT_DEVICE
 bool "Struct device SDK"
 default y
 depends on NETWORKING && NET_SOCKETS && CSPRNG_ENABLED
 help
   Requires PSA HMAC-SHA256 and ChaCha20-Poly1305 support from the board's
   maintained crypto provider. Network and clock setup are application-owned.
endmenu
```
